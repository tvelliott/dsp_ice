#include <stdint.h>
#include <string.h>
#include <stdlib.h>

/*  ------------------------------------------------------------------------------------

   The MIT License (MIT)
   Copyright (c) 2011, 2016, Len Shustek

  Permission is hereby granted, free of charge, to any person obtaining a copy of
  this software and associated documentation files (the "Software"), to deal in
  the Software without restriction, including without limitation the rights to use,
  copy, modify, merge, publish, distribute, sublicense, and/or sell copies of the
  Software, and to permit persons to whom the Software is furnished to do so,
  subject to the following conditions:

  The above copyright notice and this permission notice shall be included in all
  copies or substantial portions of the Software.

  THE SOFTWARE IS PROVIDED "AS IS", WITHOUT WARRANTY OF ANY KIND, EXPRESS OR
  IMPLIED, INCLUDING BUT NOT LIMITED TO THE WARRANTIES OF MERCHANTABILITY,
  FITNESS FOR A PARTICULAR PURPOSE AND NONINFRINGEMENT. IN NO EVENT SHALL THE
  AUTHORS OR COPYRIGHT HOLDERS BE LIABLE FOR ANY CLAIM, DAMAGES OR OTHER
  LIABILITY, WHETHER IN AN ACTION OF CONTRACT, TORT OR OTHERWISE, ARISING
  FROM, OUT OF OR IN CONNECTION WITH THE SOFTWARE OR THE USE OR OTHER
  DEALINGS IN THE SOFTWARE.
**************************************************************************************/

//t.elliott - stripped all the timer stuff, implemented simple instrument change to work on DSP-ICE


#include "Playtune.h"

int8_t do_debug_midi=1;


#define ASSUME_VOLUME 1 // assume volume information is present in bytestream files without headers?


file_hdr_t file_header;

/////////////////////////////////////////////////////////////////////////////
/////////////////////////////////////////////////////////////////////////////
const uint16_t tune_frequencies[128] = {
  16, 17, 18, 19, 21, 22, 23, 24, 26, 28, 29, 31, 33, 35, 37, 39, 41,
  44, 46, 49, 52, 55, 58, 62, 65, 69, 73, 78, 82, 87, 92, 98, 104, 110,
  117, 123, 131, 139, 147, 156, 165, 175, 185, 196, 208, 220, 233,
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  22351, 23680, 25088
};

#define HDR_F1_VOLUME_PRESENT 0x80
#define HDR_F1_INSTRUMENTS_PRESENT 0x40
#define HDR_F1_PERCUSSION_PRESENT 0x20


int tune_playing;
int volume_present;
const int8_t *score_start;
const int8_t *score_cursor;
int _tune_num_chans=4;
static int cmd, opcode, chan, note;
static int16_t duration;
static int instrument;

static int ch1_enable=1;
static int ch2_enable=1;
static int ch3_enable=1;
static int ch4_enable=1;
static int ch5_enable=1;
static int ch6_enable=1;
static int ch7_enable=1;
static int ch8_enable=1;

///////////////////////////////////////////////////////////////////////////
///////////////////////////////////////////////////////////////////////////
void tune_playnote (int8_t chan, int8_t note)
{
  if(note>127) note=127;
  uint16_t freq = tune_frequencies[note];

  if(chan==0 && !ch1_enable) freq=0;
  if(chan==1 && !ch2_enable) freq=0;
  if(chan==2 && !ch3_enable) freq=0;
  if(chan==3 && !ch4_enable) freq=0;
  if(chan==4 && !ch5_enable) freq=0;
  if(chan==5 && !ch6_enable) freq=0;
  if(chan==6 && !ch7_enable) freq=0;
  if(chan==7 && !ch8_enable) freq=0;

  uint16_t *chan_ptr;
  if(chan==0) chan_ptr = (uint16_t *) 0x60001006;
  if(chan==1) chan_ptr = (uint16_t *) 0x60001008;
  if(chan==2) chan_ptr = (uint16_t *) 0x6000100a;
  if(chan==3) chan_ptr = (uint16_t *) 0x6000100c;
  if(chan==4) chan_ptr = (uint16_t *) 0x6000100e;
  if(chan==5) chan_ptr = (uint16_t *) 0x60001010;
  if(chan==6) chan_ptr = (uint16_t *) 0x60001012;
  if(chan==7) chan_ptr = (uint16_t *) 0x60001014;

  *chan_ptr = freq;
}

///////////////////////////////////////////////////////////////////////////
///////////////////////////////////////////////////////////////////////////
void set_midi_channel_mask (uint8_t chan_mask)
{

  if( chan_mask&0x80 ) ch8_enable=1;
  else ch8_enable=0;

  if( chan_mask&0x40 ) ch7_enable=1;
  else ch7_enable=0;

  if( chan_mask&0x20 ) ch6_enable=1;
  else ch6_enable=0;

  if( chan_mask&0x10 ) ch5_enable=1;
  else ch5_enable=0;

  if( chan_mask&0x08 ) ch4_enable=1;
  else ch4_enable=0;

  if( chan_mask&0x04 ) ch3_enable=1;
  else ch3_enable=0;

  if( chan_mask&0x02 ) ch2_enable=1;
  else ch2_enable=0;

  if( chan_mask&0x01 ) ch1_enable=1;
  else ch1_enable=0;

  printf("\r\nchannel mask: %02x", chan_mask);
}

///////////////////////////////////////////////////////////////////////////
///////////////////////////////////////////////////////////////////////////

void tune_stopnote (int8_t chan)
{
  uint16_t *chan_ptr;
  if(chan==0) chan_ptr = (uint16_t *) 0x60001006;
  if(chan==1) chan_ptr = (uint16_t *) 0x60001008;
  if(chan==2) chan_ptr = (uint16_t *) 0x6000100a;
  if(chan==3) chan_ptr = (uint16_t *) 0x6000100c;
  if(chan==4) chan_ptr = (uint16_t *) 0x6000100e;
  if(chan==5) chan_ptr = (uint16_t *) 0x60001010;
  if(chan==6) chan_ptr = (uint16_t *) 0x60001012;
  if(chan==7) chan_ptr = (uint16_t *) 0x60001014;
  *chan_ptr = 0;
}

///////////////////////////////////////////////////////////////////////////
///////////////////////////////////////////////////////////////////////////

void change_instrument(int chan, int instrument)
{
  uint8_t val = 0x01;
  if(instrument>=9 && instrument<=16) val = 0x03; //some kind of percussion instrument,  use noise waveform

  uint16_t *wave_ptr = (uint16_t *) 0x60001016;
  uint16_t wreg = *wave_ptr;

  uint16_t w1 = (wreg>>0)&0x03;
  uint16_t w2 = (wreg>>2)&0x03;
  uint16_t w3 = (wreg>>4)&0x03;
  uint16_t w4 = (wreg>>6)&0x03;
  uint16_t w5 = (wreg>>8)&0x03;
  uint16_t w6 = (wreg>>10)&0x03;
  uint16_t w7 = (wreg>>12)&0x03;
  uint16_t w8 = (wreg>>14)&0x03;

  if(chan==0) w1=val;
  if(chan==1) w2=val;
  if(chan==2) w3=val;
  if(chan==3) w4=val;
  if(chan==4) w5=val;
  if(chan==5) w6=val;
  if(chan==6) w7=val;
  if(chan==7) w8=val;

  wreg = 0;
  wreg |= w1;
  wreg |= w2<<2;
  wreg |= w3<<4;
  wreg |= w4<<6;
  wreg |= w5<<8;
  wreg |= w6<<10;
  wreg |= w7<<12;
  wreg |= w8<<14;

  *wave_ptr = wreg;

  if(do_debug_midi) printf("\r\nchange instrument: ch: %u,  instr: %u, mask: %04x", chan, instrument, wreg);
}

///////////////////////////////////////////////////////////////////////////
///////////////////////////////////////////////////////////////////////////
void tune_playscore (const int8_t *score)
{
  if (tune_playing) tune_stopscore();
  score_start = score;

  volume_present = ASSUME_VOLUME;

  // look for the optional file header
  memcpy(&file_header, score, sizeof(file_hdr_t)); // copy possible header from PROGMEM to RAM
  if (file_header.id1 == 'P' && file_header.id2 == 't') { // validate it
    volume_present = file_header.f1 & HDR_F1_VOLUME_PRESENT;
    score_start += file_header.hdr_length; // skip the whole header
  }
  score_cursor = score_start;
  tune_stepscore();  /* execute initial commands */
  tune_playing = 1;  /* release the interrupt routine */
  duration=500;
}

///////////////////////////////////////////////////////////////////////////
///////////////////////////////////////////////////////////////////////////
void tune_stepscore (void)
{
  /* Do score commands until a "wait" is found, or the score is stopped.
    This is called initially from tune_playcore, but then is called
    from the interrupt routine when waits expire.
  */
#define CMD_PLAYNOTE  0x90  /* play a note: low nibble is generator #, note is next byte */
#define CMD_STOPNOTE  0x80  /* stop a note: low nibble is generator # */
#define CMD_INSTRUMENT  0xc0 /* change instrument; low nibble is generator #, instrument is next byte */
#define CMD_RESTART 0xe0  /* restart the score from the beginning */
#define CMD_STOP  0xf0  /* stop playing */
  /* if CMD < 0x80, then the other 7 bits and the next byte are a 15-bit big-endian number of msec to wait */

  if(duration==0) {
    cmd = (uint8_t) *score_cursor++;

    opcode = cmd & 0xf0;
    chan = cmd & 0x0f;

    if( (cmd&0x80) ==0) {

      duration = (int16_t) (cmd&0xff);
      duration *= 256;
      duration |= (int16_t) (*score_cursor++&0xff);

      if(duration<0) duration=0;

      if(duration>10000) duration=10000;
      if(duration<10) {
        duration=0;
      } else {
        if(do_debug_midi) printf("\r\nduration: %d", duration);
      }
      return;
    }

    if (opcode == CMD_STOPNOTE) { /* stop note */
      tune_stopnote (chan);
    } else if (opcode == CMD_PLAYNOTE) { /* play note */
      note = *score_cursor++; // argument evaluation order is undefined in C!
      //if(volume_present) score_cursor++;
      tune_playnote (chan, note);

      uint16_t freq = tune_frequencies[note];
      if(do_debug_midi) printf("\r\nchan: %d, freq: %d", chan, freq);
    } else if (opcode == CMD_INSTRUMENT) { /* change a channel's instrument */
      uint8_t inst = *score_cursor++;

      change_instrument(chan, inst);
    } else if (opcode == CMD_RESTART) { /* restart score */
      score_cursor = score_start;
    } else if (opcode == CMD_STOP) { /* stop score */
      tune_playing = 0;
      tune_stopnote(0);
      tune_stopnote(1);
      tune_stopnote(2);
      tune_stopnote(3);
      tune_stopnote(4);
      tune_stopnote(5);
      tune_stopnote(6);
      tune_stopnote(7);

      print_prompt();
    }
  } else {
    duration--;
    //printf("\r\nduration: %d", duration);
  }
}

///////////////////////////////////////////////////////////////////////////
///////////////////////////////////////////////////////////////////////////
void tune_stopscore (void)
{
  int i;
  for (i = 0; i < _tune_num_chans; ++i)
    tune_stopnote(i);
  tune_playing = 0;
}

///////////////////////////////////////////////////////////////////////////
///////////////////////////////////////////////////////////////////////////
void tune_stopchans(void)
{
}

const uint8_t score1[] = {
  'P','t', 6, 0x40, 0x00,  8, // (Playtune file header)
// Know Your Enemy
// Rage Against the Machine
  0xC0,29, 0x90,61, 0xC1,37, 0x91,30, 0xC2,16, 0x92,46, 0xC3,29, 0x93,54, 0xC4,16, 0x94,36, 0xC5,16, 0x95,36, 0,91,
  0x80, 0x82, 0x83, 0x84, 0x85, 0,91, 0x90,59, 0x93,52, 0,91, 0x80, 0x83, 0,91, 0x92,44, 0x90,61, 0x93,54, 0x81, 0,91,
  0x80, 0x82, 0x83, 0,91, 0x90,59, 0x93,52, 0,91, 0x80, 0x83, 0,91, 0x90,61, 0x93,54, 0,91, 0x80, 0x83, 0,91, 0x90,64,
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  0x85, 0x86, 0xf0
};
